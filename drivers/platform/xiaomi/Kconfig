## drivers/platform/xiaomi/Kconfig
```kconfig
# Xiaomi configuration options

config MACH_XIAOMI
	bool "Xiaomi device"
	depends on ARCH_QCOM
	help
	  Support for Xiaomi products

config MACH_XIAOMI_MSM8996
	bool "Xiaomi MSM8996"
	depends on ARCH_MSM8996
	select MACH_XIAOMI
	help
	  Support for MSM8996 Xiaomi variants

menu "Xiaomi board selection"

config MACH_XIAOMI_A1
	bool "A1 board"
	select MACH_XIAOMI_MSM8996
	help
	  Support for Xiaomi Mi 5 (gemini)

config MACH_XIAOMI_A4
	bool "A4 board"
	select MACH_XIAOMI_MSM8996
	help
	  Support for Xiaomi Mi Note 2 (scorpio)


endmenu
```
